## meta-rzt2h/conf/layer.conf
```bitbake
# We have a conf and classes directory, add to BBPATH
BBPATH .= ":${LAYERDIR}"

include ${LAYERDIR}/include/openamp.inc

# Support for BL2 load firmware (Remove '#' for support and sectect target core)
#MACHINE_FEATURES:append = " RZT2H_CA55_CR52_BL2_BOOT"
# Choose one target core for BL2 firmware loading
#MACHINE_FEATURES:append = " RZT2H_CA551_BL2_BOOT"
#MACHINE_FEATURES:append = " RZT2H_CA552_BL2_BOOT"
#MACHINE_FEATURES:append = " RZT2H_CA553_BL2_BOOT"
#MACHINE_FEATURES:append = " RZT2H_CR520_BL2_BOOT"
#MACHINE_FEATURES:append = " RZT2H_CR521_BL2_BOOT"

# Support for u-boot ("0" for no support and "1" for support)
ENABLE_U_BOOT ?= "0"

# Support for remoteproc ("0" for no support and "1" for support)
ENABLE_REMOTEPROC ?= "0"

# Remote core selection ("0" for R52 and "1" for A55)
RPMSG_REMOTE_CORE ?= "0"

# We have recipes-* directories, add to BBFILES
BBFILES += "${LAYERDIR}/recipes-*/*/*.bb \
            ${LAYERDIR}/recipes-*/*/*.bbappend"
	
BBFILE_COLLECTIONS += "rz-multi-os"
BBFILE_PATTERN_rz-multi-os := "^${LAYERDIR}/"

LAYERDEPENDS_rz-multi-os = "meta-rz-bsp"
LAYERSERIES_COMPAT_rz-multi-os = "scarthgap"
```
